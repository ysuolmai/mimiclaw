## sdkconfig.defaults.esp32c3
```kconfig
# MimiClaw - ESP32-C3 Super Mini Lite Target Configuration
CONFIG_IDF_TARGET="esp32c3"

# ESP32-C3 Super Mini: usually 4 MB flash, no PSRAM.
CONFIG_ESPTOOLPY_FLASHMODE_DIO=y
CONFIG_ESPTOOLPY_FLASHMODE="dio"
CONFIG_ESPTOOLPY_FLASHFREQ_40M=y
CONFIG_ESPTOOLPY_FLASHSIZE_4MB=y
CONFIG_ESPTOOLPY_FLASHSIZE="4MB"

# CPU 160MHz
CONFIG_ESP_DEFAULT_CPU_FREQ_MHZ_160=y

# Size/memory oriented build.
CONFIG_COMPILER_OPTIMIZATION_SIZE=y
CONFIG_NEWLIB_NANO_FORMAT=y

# WiFi/RAM trimming for no-PSRAM C3.
CONFIG_ESP_WIFI_STATIC_RX_BUFFER_NUM=2
CONFIG_ESP_WIFI_DYNAMIC_RX_BUFFER_NUM=4
CONFIG_ESP_WIFI_RX_BA_WIN=2
CONFIG_ESP_WIFI_ENABLE_WPA3_SAE=n
CONFIG_ESP_WIFI_ESPNOW_MAX_ENCRYPT_NUM=0
CONFIG_ESP_WIFI_ENTERPRISE_SUPPORT=n
CONFIG_LWIP_MAX_SOCKETS=6
CONFIG_LWIP_IPV6=n
CONFIG_LWIP_TCPIP_TASK_STACK_SIZE=2048
CONFIG_LWIP_TCPIP_RECVMBOX_SIZE=8

# TLS: keep buffers modest; the LLM path is still the largest runtime user.
CONFIG_MBEDTLS_DYNAMIC_FREE_CONFIG_DATA=y
CONFIG_MBEDTLS_SSL_IN_CONTENT_LEN=8192
CONFIG_MBEDTLS_SSL_OUT_CONTENT_LEN=2048

# Keep compile-time WebSocket support because ws_server.c is part of the shared source set.
# The C3-lite runtime profile does not start the WebSocket gateway.
CONFIG_HTTPD_WS_SUPPORT=y

# Custom 4MB C3 partition table.
CONFIG_PARTITION_TABLE_CUSTOM=y
CONFIG_PARTITION_TABLE_CUSTOM_FILENAME="partitions-c3.csv"

# C3 USB Serial/JTAG console.
CONFIG_ESP_CONSOLE_USB_SERIAL_JTAG=y
CONFIG_ESP_CONSOLE_SECONDARY_NONE=y
CONFIG_ESP_CONSOLE_USB_SERIAL_JTAG_ENABLED=y
```

## sdkconfig.defaults.esp32s3
```kconfig
# MimiClaw - ESP32-S3 Super Mini Target Configuration
CONFIG_IDF_TARGET="esp32s3"

# ESP32-S3 Super Mini / ESP32-S3FH4R2:
# 4 MB in-package Quad SPI flash + 2 MB in-package Quad SPI PSRAM.
CONFIG_ESPTOOLPY_FLASHMODE_QIO=y
CONFIG_ESPTOOLPY_FLASHMODE="qio"
CONFIG_ESPTOOLPY_FLASHFREQ_80M=y
CONFIG_ESPTOOLPY_FLASHSIZE_4MB=y
CONFIG_ESPTOOLPY_FLASHSIZE="4MB"

# CPU 240MHz
CONFIG_ESP_DEFAULT_CPU_FREQ_MHZ_240=y

# PSRAM 2MB Quad
CONFIG_SPIRAM=y
CONFIG_SPIRAM_MODE_QUAD=y
CONFIG_SPIRAM_TYPE_AUTO=y
CONFIG_SPIRAM_SPEED_80M=y
CONFIG_SPIRAM_USE_MALLOC=y
CONFIG_SPIRAM_MALLOC_ALWAYSINTERNAL=16384
CONFIG_SPIRAM_MALLOC_RESERVE_INTERNAL=32768
CONFIG_SPIRAM_MEMTEST=n
CONFIG_SPIRAM_XIP_FROM_PSRAM=n
CONFIG_SPIRAM_FETCH_INSTRUCTIONS=n
CONFIG_SPIRAM_RODATA=n
CONFIG_FREERTOS_TASK_CREATE_ALLOW_EXT_MEM=n

# WiFi memory optimization
CONFIG_ESP_WIFI_STATIC_RX_BUFFER_NUM=3
CONFIG_ESP_WIFI_DYNAMIC_RX_BUFFER_NUM=6
CONFIG_ESP_WIFI_RX_BA_WIN=3
CONFIG_ESP_WIFI_ENABLE_WPA3_SAE=n
CONFIG_ESP_WIFI_ESPNOW_MAX_ENCRYPT_NUM=0
CONFIG_ESP_WIFI_ENTERPRISE_SUPPORT=n
CONFIG_LWIP_MAX_SOCKETS=10
CONFIG_LWIP_IPV6=n
CONFIG_LWIP_TCPIP_TASK_STACK_SIZE=2048
CONFIG_LWIP_TCPIP_RECVMBOX_SIZE=16

# TLS optimization (PSRAM allocation + small buffers)
CONFIG_MBEDTLS_EXTERNAL_MEM_ALLOC=y
CONFIG_MBEDTLS_DYNAMIC_FREE_CONFIG_DATA=y
CONFIG_MBEDTLS_SSL_IN_CONTENT_LEN=16384
CONFIG_MBEDTLS_SSL_OUT_CONTENT_LEN=4096
CONFIG_NEWLIB_NANO_FORMAT=y
CONFIG_COMPILER_OPTIMIZATION_SIZE=y

# WebSocket support
CONFIG_HTTPD_WS_SUPPORT=y

# Custom 4MB partition table
CONFIG_PARTITION_TABLE_CUSTOM=y
CONFIG_PARTITION_TABLE_CUSTOM_FILENAME="partitions.csv"

# Console: USB Serial/JTAG primary (supports both input and output via USB)
# ESP-IDF v5.5+ has TX timeout protection (50ms) so device won't hang
# when no USB host is connected.
CONFIG_ESP_CONSOLE_USB_SERIAL_JTAG=y
CONFIG_ESP_CONSOLE_SECONDARY_NONE=y
CONFIG_ESP_CONSOLE_USB_SERIAL_JTAG_ENABLED=y
```
